## components/esp_psram/esp32c5/Kconfig.spiram
```kconfig
config SPIRAM
    bool "Support for external, SPI-connected RAM"
    default "n"
    help
        This enables support for an external SPI RAM chip, connected in parallel with the
        main SPI flash chip.

menu "SPI RAM config"
    depends on SPIRAM

    choice SPIRAM_MODE
        prompt "Mode of SPI RAM chip in use"
        default SPIRAM_MODE_QUAD

        config SPIRAM_MODE_QUAD
            bool "Quad Mode PSRAM"

    endchoice

    choice SPIRAM_SPEED
        prompt "Set RAM clock speed"
        default SPIRAM_SPEED_40M
        help
            Select the speed for the SPI RAM chip.

        config SPIRAM_SPEED_80M
            bool "80MHz clock speed"
        config SPIRAM_SPEED_40M
            bool "40Mhz clock speed"
    endchoice

    config SPIRAM_SPEED
        int
        default 80 if SPIRAM_SPEED_80M
        default 40 if SPIRAM_SPEED_40M

    config SPIRAM_XIP_FROM_PSRAM
        bool "Enable Executable in place from (XiP) from PSRAM feature (READ HELP)"
        default n
        select SPIRAM_FETCH_INSTRUCTIONS
        select SPIRAM_RODATA
        select SPIRAM_FLASH_LOAD_TO_PSRAM
        help
            Helper for selecting both `SPIRAM_FETCH_INSTRUCTIONS`, `SPIRAM_RODATA`, `SPIRAM_FLASH_LOAD_TO_PSRAM`

    config SPIRAM_FETCH_INSTRUCTIONS
        bool "Move Instructions in Flash to PSRAM"
        default n
        select SPIRAM_FLASH_LOAD_TO_PSRAM
        help
            If enabled, instructions in flash will be moved into PSRAM on startup.
            If SPIRAM_RODATA is also enabled, code that requires execution during an MSPI1 Flash operation
            can forgo being placed in IRAM. Therefore codes that need to be executing during Flash
            operation can continue working normally.

            This feature is useful for high throughput peripheral involved applications to improve
            the performance during MSPI1 flash operations. PSRAM access speed is faster than Flash access.
            So the performance is better. (see External RAM documentation for more details).

    config SPIRAM_RODATA
        bool "Move Read-Only Data in Flash to PSRAM"
        default n
        select SPIRAM_FLASH_LOAD_TO_PSRAM
        help
            If enabled, rodata in flash will be moved into PSRAM on startup.
            If SPIRAM_FETCH_INSTRUCTIONS is also enabled, code that requires execution during an MSPI1 Flash operation
            is not necessary to be placed in IRAM. Therefore codes that need to be executing during Flash
            operation can continue working normally.

            This feature is useful for high throughput peripheral involved applications to improve
            the performance during MSPI1 flash operations. PSRAM access speed is faster than Flash access.
            So the performance is better. (see External RAM documentation for more details).

    config SPIRAM_FLASH_LOAD_TO_PSRAM
        bool "SPIRAM_FLASH_LOAD_TO_PSRAM"
        default n
        depends on SPIRAM_FETCH_INSTRUCTIONS || SPIRAM_RODATA || SPIRAM_XIP_FROM_PSRAM
        help
            This is a helper indicating this condition:
            `CONFIG_SPIRAM_XIP_FROM_PSRAM && CONFIG_IDF_TARGET_ESP32C5`

    config SPIRAM_DECOMPRESS_FETCH_INSTRUCTIONS
        bool "Application's instruction segment is decompressed when moving from the SPI Flash to PSRAM"
        depends on SPIRAM_FETCH_INSTRUCTIONS
        default n

    config SPIRAM_DECOMPRESS_RODATA
        bool "Application's rodata segment is decompressed when moving from the SPI Flash to PSRAM"
        depends on SPIRAM_RODATA
        default n

    source "$IDF_PATH/components/esp_psram/Kconfig.spiram.common"    # insert non-chip-specific items here
endmenu
```

## examples/get-started/hello_world/sdkconfig.defaults.esp32c5
```kconfig
CONFIG_ESP_PANIC_HANDLER_IRAM=y

CONFIG_SPIRAM=y
CONFIG_SPIRAM_FETCH_INSTRUCTIONS=y
CONFIG_SPIRAM_RODATA=y
CONFIG_SPIRAM_XIP_FROM_PSRAM=y
CONFIG_SPIRAM_FLASH_LOAD_TO_PSRAM=y
CONFIG_SPIRAM_BOOT_INIT=y

# only for debugging
CONFIG_BOOTLOADER_WDT_ENABLE=n
CONFIG_ESP_SYSTEM_PANIC_PRINT_HALT=y
```

## examples/protocols/https_request/sdkconfig.defaults.esp32c61
```kconfig
CONFIG_ESP_PANIC_HANDLER_IRAM=y

CONFIG_SPIRAM=y
CONFIG_SPIRAM_FETCH_INSTRUCTIONS=y
CONFIG_SPIRAM_RODATA=y
CONFIG_SPIRAM_XIP_FROM_PSRAM=y
CONFIG_SPIRAM_FLASH_LOAD_TO_PSRAM=y
CONFIG_SPIRAM_BOOT_INIT=n
CONFIG_SPIRAM_DECOMPRESS_FETCH_INSTRUCTIONS=y
CONFIG_SPIRAM_DECOMPRESS_RODATA=y

CONFIG_ESP_SYSTEM_PMP_IDRAM_SPLIT=n

# only for debugging
CONFIG_BOOTLOADER_WDT_ENABLE=n
CONFIG_ESP_SYSTEM_PANIC_PRINT_HALT=y
```

## examples/provisioning/wifi_prov_mgr/sdkconfig.defaults.esp32c5
```kconfig
CONFIG_ESP_PANIC_HANDLER_IRAM=y

CONFIG_SPIRAM=y
CONFIG_SPIRAM_BOOT_INIT=n

CONFIG_ESP_SYSTEM_PMP_IDRAM_SPLIT=n

CONFIG_MBEDTLS_CERTIFICATE_BUNDLE=y

# only for debugging
CONFIG_BOOTLOADER_WDT_ENABLE=n
CONFIG_ESP_SYSTEM_PANIC_PRINT_HALT=y
CONFIG_EXAMPLE_REPROVISIONING=n
```
